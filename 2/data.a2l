/******************************************************************************
* ASAP2 file: text28.a2l
* Code generation for model "text28".
* Model version : 1.154
* Simulink Coder version : 8.6 (R2014a) 27-Dec-2013
* C source code generated on : Thu Sep 12 21:55:35 2024
* Target selection: ec55xx.tlc
* Embedded hardware selection: Freescale MPC5500
* Code generation objectives: Unspecified
* Validation result: Not run
* (add additional file header information here)
******************************************************************************/ ASAP2_VERSION 1 31
/* Version 1.31 */
/begin PROJECT ECUCoderProject "ECUCoder Project"
/begin HEADER "Header Comments go here" /end HEADER
/begin MODULE ModuleName "No Comment"
/begin MOD_PAR "No Comment" /end MOD_PAR
/begin MOD_COMMON "No Comment" BYTE_ORDER MSB_FIRST /end MOD_COMMON
/begin RECORD_LAYOUT Scalar_BOOLEAN FNC_VALUES 1 UBYTE COLUMN_DIR DIRECT /end RECORD_LAYOUT
/begin RECORD_LAYOUT Scalar_UBYTE FNC_VALUES 1 UBYTE COLUMN_DIR DIRECT /end RECORD_LAYOUT
/begin RECORD_LAYOUT Scalar_BYTE FNC_VALUES 1 SBYTE COLUMN_DIR DIRECT /end RECORD_LAYOUT
/begin RECORD_LAYOUT Scalar_UWORD FNC_VALUES 1 UWORD COLUMN_DIR DIRECT /end RECORD_LAYOUT
/begin RECORD_LAYOUT Scalar_SWORD FNC_VALUES 1 SWORD COLUMN_DIR DIRECT /end RECORD_LAYOUT
/begin RECORD_LAYOUT Scalar_ULONG FNC_VALUES 1 ULONG COLUMN_DIR DIRECT /end RECORD_LAYOUT
/begin RECORD_LAYOUT Scalar_LONG FNC_VALUES 1 SLONG COLUMN_DIR DIRECT /end RECORD_LAYOUT
/begin RECORD_LAYOUT Scalar_FLOAT32_IEEE FNC_VALUES 1 FLOAT32_IEEE COLUMN_DIR DIRECT /end RECORD_LAYOUT
/begin RECORD_LAYOUT Scalar_FLOAT64_IEEE FNC_VALUES 1 FLOAT64_IEEE COLUMN_DIR DIRECT /end RECORD_LAYOUT
/begin RECORD_LAYOUT Lookup1D_BYTE FNC_VALUES 1 SBYTE COLUMN_DIR DIRECT /end RECORD_LAYOUT
/begin RECORD_LAYOUT Lookup1D_X_BYTE AXIS_PTS_X 1 SBYTE INDEX_INCR DIRECT /end RECORD_LAYOUT
/begin RECORD_LAYOUT Lookup1D_UBYTE FNC_VALUES 1 UBYTE COLUMN_DIR DIRECT /end RECORD_LAYOUT
/begin RECORD_LAYOUT Lookup1D_X_UBYTE AXIS_PTS_X 1 UBYTE INDEX_INCR DIRECT /end RECORD_LAYOUT
/begin RECORD_LAYOUT Lookup1D_UWORD FNC_VALUES 1 UWORD COLUMN_DIR DIRECT /end RECORD_LAYOUT
/begin RECORD_LAYOUT Lookup1D_X_UWORD AXIS_PTS_X 1 UWORD INDEX_INCR DIRECT /end RECORD_LAYOUT
/begin RECORD_LAYOUT Lookup1D_WORD FNC_VALUES 1 SWORD COLUMN_DIR DIRECT /end RECORD_LAYOUT
/begin RECORD_LAYOUT Lookup1D_X_WORD AXIS_PTS_X 1 SWORD INDEX_INCR DIRECT /end RECORD_LAYOUT
/begin RECORD_LAYOUT Lookup1D_ULONG FNC_VALUES 1 ULONG COLUMN_DIR DIRECT /end RECORD_LAYOUT
/begin RECORD_LAYOUT Lookup1D_X_ULONG AXIS_PTS_X 1 ULONG INDEX_INCR DIRECT /end RECORD_LAYOUT
/begin RECORD_LAYOUT Lookup1D_SLONG FNC_VALUES 1 SLONG COLUMN_DIR DIRECT /end RECORD_LAYOUT
/begin RECORD_LAYOUT Lookup1D_X_LONG AXIS_PTS_X 1 SLONG INDEX_INCR DIRECT /end RECORD_LAYOUT
/begin RECORD_LAYOUT Lookup1D_FLOAT32_IEEE FNC_VALUES 1 FLOAT32_IEEE COLUMN_DIR DIRECT /end RECORD_LAYOUT
/begin RECORD_LAYOUT Lookup1D_X_FLOAT32_IEEE AXIS_PTS_X 1 FLOAT32_IEEE INDEX_INCR DIRECT /end RECORD_LAYOUT
/begin RECORD_LAYOUT Lookup1D_FLOAT64_IEEE FNC_VALUES 1 FLOAT64_IEEE COLUMN_DIR DIRECT /end RECORD_LAYOUT
/begin RECORD_LAYOUT Lookup1D_X_FLOAT64_IEEE AXIS_PTS_X 1 FLOAT64_IEEE INDEX_INCR DIRECT /end RECORD_LAYOUT
/begin RECORD_LAYOUT Lookup2D_UBYTE FNC_VALUES 1 UBYTE COLUMN_DIR DIRECT /end RECORD_LAYOUT
/begin RECORD_LAYOUT Lookup2D_X_UBYTE AXIS_PTS_X 1 UBYTE INDEX_INCR DIRECT /end RECORD_LAYOUT
/begin RECORD_LAYOUT Lookup2D_BYTE FNC_VALUES 1 SBYTE COLUMN_DIR DIRECT /end RECORD_LAYOUT
/begin RECORD_LAYOUT Lookup2D_X_BYTE AXIS_PTS_X 1 SBYTE INDEX_INCR DIRECT /end RECORD_LAYOUT
/begin RECORD_LAYOUT Lookup2D_UWORD FNC_VALUES 1 UWORD COLUMN_DIR DIRECT /end RECORD_LAYOUT
/begin RECORD_LAYOUT Lookup2D_X_UWORD AXIS_PTS_X 1 UWORD INDEX_INCR DIRECT /end RECORD_LAYOUT
/begin RECORD_LAYOUT Lookup2D_WORD FNC_VALUES 1 SWORD COLUMN_DIR DIRECT /end RECORD_LAYOUT
/begin RECORD_LAYOUT Lookup2D_X_WORD AXIS_PTS_X 1 SWORD INDEX_INCR DIRECT /end RECORD_LAYOUT
/begin RECORD_LAYOUT Lookup2D_ULONG FNC_VALUES 1 ULONG COLUMN_DIR DIRECT /end RECORD_LAYOUT
/begin RECORD_LAYOUT Lookup2D_X_ULONG AXIS_PTS_X 1 ULONG INDEX_INCR DIRECT /end RECORD_LAYOUT
/begin RECORD_LAYOUT Lookup2D_LONG FNC_VALUES 1 SLONG COLUMN_DIR DIRECT /end RECORD_LAYOUT
/begin RECORD_LAYOUT Lookup2D_X_LONG AXIS_PTS_X 1 SLONG INDEX_INCR DIRECT /end RECORD_LAYOUT
/begin RECORD_LAYOUT Lookup2D_FLOAT32_IEEE FNC_VALUES 1 FLOAT32_IEEE COLUMN_DIR DIRECT /end RECORD_LAYOUT
/begin RECORD_LAYOUT Lookup2D_X_FLOAT32_IEEE AXIS_PTS_X 1 FLOAT32_IEEE INDEX_INCR DIRECT /end RECORD_LAYOUT
/begin RECORD_LAYOUT Lookup2D_FLOAT64_IEEE FNC_VALUES 1 FLOAT64_IEEE COLUMN_DIR DIRECT /end RECORD_LAYOUT
/begin RECORD_LAYOUT Lookup2D_X_FLOAT64_IEEE AXIS_PTS_X 1 FLOAT64_IEEE INDEX_INCR DIRECT /end RECORD_LAYOUT
/begin MEASUREMENT bms_sign1 "" FLOAT64_IEEE text28_CM_double 0 0 -1.7E+308 1.7E+308 ECU_ADDRESS 0x40001c68 /end MEASUREMENT
/begin MEASUREMENT daishi "" FLOAT64_IEEE text28_CM_double 0 0 -1.7E+308 1.7E+308 ECU_ADDRESS 0x40001c58 /end MEASUREMENT
/begin MEASUREMENT enable_sign "" FLOAT64_IEEE text28_CM_double 0 0 -1.7E+308 1.7E+308 ECU_ADDRESS 0x40001c48 /end MEASUREMENT
/begin MEASUREMENT apps_rule "" FLOAT64_IEEE text28_CM_double 0 0 -1.7E+308 1.7E+308 ECU_ADDRESS 0x40001c90 /end MEASUREMENT
/begin MEASUREMENT zuizhong "" FLOAT64_IEEE text28_CM_double 0 0 -1.7E+308 1.7E+308 ECU_ADDRESS 0x40001bd8 /end MEASUREMENT
/begin MEASUREMENT app_scs "" FLOAT64_IEEE text28_CM_double 0 0 -1.7E+308 1.7E+308 ECU_ADDRESS 0x40001ca8 /end MEASUREMENT
/begin MEASUREMENT left_speed "" FLOAT64_IEEE text28_CM_double 0 0 -1.7E+308 1.7E+308 ECU_ADDRESS 0x40001c20 /end MEASUREMENT
/begin MEASUREMENT right_speed "" FLOAT64_IEEE text28_CM_double 0 0 -1.7E+308 1.7E+308 ECU_ADDRESS 0x40001c00 /end MEASUREMENT
/begin MEASUREMENT car_speed "" FLOAT64_IEEE text28_CM_double 0 0 -1.7E+308 1.7E+308 ECU_ADDRESS 0x40001c60 /end MEASUREMENT
/begin MEASUREMENT motor_speed "" FLOAT64_IEEE text28_CM_double 0 0 -1.7E+308 1.7E+308 ECU_ADDRESS 0x40001c18 /end MEASUREMENT
/begin MEASUREMENT rear_speed "" FLOAT64_IEEE text28_CM_double 0 0 -1.7E+308 1.7E+308 ECU_ADDRESS 0x40001c08 /end MEASUREMENT
/begin MEASUREMENT huazhuan "" FLOAT64_IEEE text28_CM_double 0 0 -1.7E+308 1.7E+308 ECU_ADDRESS 0x40001c40 /end MEASUREMENT
/begin MEASUREMENT motor_torque "" FLOAT64_IEEE text28_CM_double 0 0 -1.7E+308 1.7E+308 ECU_ADDRESS 0x40001c10 /end MEASUREMENT
/begin MEASUREMENT baifenbi1 "" FLOAT64_IEEE text28_CM_double 0 0 -1.7E+308 1.7E+308 ECU_ADDRESS 0x40001c88 /end MEASUREMENT
/begin MEASUREMENT baifenbi2 "" FLOAT64_IEEE text28_CM_double 0 0 -1.7E+308 1.7E+308 ECU_ADDRESS 0x40001c80 /end MEASUREMENT
/begin MEASUREMENT baifenbi3 "" FLOAT64_IEEE text28_CM_double 0 0 -1.7E+308 1.7E+308 ECU_ADDRESS 0x40001c78 /end MEASUREMENT
/begin MEASUREMENT jiaodu1 "" FLOAT64_IEEE text28_CM_double 0 0 -1.7E+308 1.7E+308 ECU_ADDRESS 0x40001c38 /end MEASUREMENT
/begin MEASUREMENT jiaodu2 "" FLOAT64_IEEE text28_CM_double 0 0 -1.7E+308 1.7E+308 ECU_ADDRESS 0x40001c30 /end MEASUREMENT
/begin MEASUREMENT apple "" FLOAT64_IEEE text28_CM_double 0 0 -1.7E+308 1.7E+308 ECU_ADDRESS 0x40001ca0 /end MEASUREMENT
/begin MEASUREMENT apps_erro "" FLOAT64_IEEE text28_CM_double 0 0 -1.7E+308 1.7E+308 ECU_ADDRESS 0x40001c98 /end MEASUREMENT
/begin MEASUREMENT app_date1 "" FLOAT64_IEEE text28_CM_double 0 0 -1.7E+308 1.7E+308 ECU_ADDRESS 0x40001cb8 /end MEASUREMENT
/begin MEASUREMENT app_date2 "" FLOAT64_IEEE text28_CM_double 0 0 -1.7E+308 1.7E+308 ECU_ADDRESS 0x40001cb0 /end MEASUREMENT
/begin MEASUREMENT app_baifenbi "" FLOAT64_IEEE text28_CM_double 0 0 -1.7E+308 1.7E+308 ECU_ADDRESS 0x40001cc0 /end MEASUREMENT
/begin MEASUREMENT youya2 "" FLOAT64_IEEE text28_CM_double 0 0 -1.7E+308 1.7E+308 ECU_ADDRESS 0x40001bf0 /end MEASUREMENT
/begin MEASUREMENT youya3 "" FLOAT64_IEEE text28_CM_double 0 0 -1.7E+308 1.7E+308 ECU_ADDRESS 0x40001be8 /end MEASUREMENT
/begin MEASUREMENT MotorTemp "" FLOAT32_IEEE text28_CM_single 0 0 -3.4E+38 3.4E+38 ECU_ADDRESS 0x40001ccc /end MEASUREMENT
/begin MEASUREMENT McuTemp "" FLOAT32_IEEE text28_CM_single 0 0 -3.4E+38 3.4E+38 ECU_ADDRESS 0x40001cd0 /end MEASUREMENT
/begin MEASUREMENT baojing "" FLOAT32_IEEE text28_CM_single 0 0 -3.4E+38 3.4E+38 ECU_ADDRESS 0x40001c74 /end MEASUREMENT
/begin MEASUREMENT zhuangtai "" FLOAT32_IEEE text28_CM_single 0 0 -3.4E+38 3.4E+38 ECU_ADDRESS 0x40001be0 /end MEASUREMENT
/begin MEASUREMENT soc "" FLOAT32_IEEE text28_CM_single 0 0 -3.4E+38 3.4E+38 ECU_ADDRESS 0x40001bfc /end MEASUREMENT
/begin MEASUREMENT dianya "" FLOAT32_IEEE text28_CM_single 0 0 -3.4E+38 3.4E+38 ECU_ADDRESS 0x40001c50 /end MEASUREMENT
/begin MEASUREMENT keshi "" ULONG text28_CM_uint32 0 0 0 4294967295 ECU_ADDRESS 0x40001c28 /end MEASUREMENT
/begin MEASUREMENT anquan_out "" ULONG text28_CM_uint32 0 0 0 4294967295 ECU_ADDRESS 0x40001cc8 /end MEASUREMENT
/begin MEASUREMENT jiaodu_11111 "" UWORD text28_CM_uint16 0 0 0 65535 ECU_ADDRESS 0x40001c2e /end MEASUREMENT
/begin MEASUREMENT jiaodu_2222 "" UWORD text28_CM_uint16 0 0 0 65535 ECU_ADDRESS 0x40001c2c /end MEASUREMENT
/begin MEASUREMENT youya1 "" UWORD text28_CM_uint16 0 0 0 65535 ECU_ADDRESS 0x40001bf8 /end MEASUREMENT
/begin MEASUREMENT bms_canok "" UBYTE text28_CM_uint8 0 0 0 255 ECU_ADDRESS 0x40001c71 /end MEASUREMENT
/begin MEASUREMENT CAN_ok "" UBYTE text28_CM_uint8 0 0 0 255 ECU_ADDRESS 0x40001cd5 /end MEASUREMENT
/begin MEASUREMENT FAN_sign "" UBYTE text28_CM_boolean 0 0 0 1 ECU_ADDRESS 0x40001cd4 /end MEASUREMENT
/begin MEASUREMENT bms_sign "" UBYTE text28_CM_boolean 0 0 0 1 ECU_ADDRESS 0x40001c70 /end MEASUREMENT
/begin COMPU_METHOD text28_CM_double "Q = V" RAT_FUNC "%15.10" "" COEFFS 0 1 0 0 0 1 /end COMPU_METHOD
/begin COMPU_METHOD text28_CM_single "Q = V" RAT_FUNC "%8.6" "" COEFFS 0 1 0 0 0 1 /end COMPU_METHOD
/begin COMPU_METHOD text28_CM_uint32 "Q = V" RAT_FUNC "%10.0" "" COEFFS 0 1 0 0 0 1 /end COMPU_METHOD
/begin COMPU_METHOD text28_CM_uint16 "Q = V" RAT_FUNC "%5.0" "" COEFFS 0 1 0 0 0 1 /end COMPU_METHOD
/begin COMPU_METHOD text28_CM_uint8 "Q = V" RAT_FUNC "%3.0" "" COEFFS 0 1 0 0 0 1 /end COMPU_METHOD
/begin COMPU_METHOD text28_CM_boolean "Q = V" RAT_FUNC "%1.0" "" COEFFS 0 1 0 0 0 1 /end COMPU_METHOD
/begin GROUP text28 "text28" /* Root */ ROOT
 /begin SUB_GROUP Root_Function_Call_Subsystem4 Root_Function_Call_Subsystem7 Root_____ /end SUB_GROUP
/end GROUP
/begin GROUP Root_Function_Call_Subsystem4 "text28/Function-Call Subsystem4" /begin SUB_GROUP S3_ReceiveMessages S3___ S3_can___ /end SUB_GROUP /begin REF_MEASUREMENT bms_canok bms_sign /end REF_MEASUREMENT /end GROUP
/begin GROUP Root_Function_Call_Subsystem7 "text28/Function-Call Subsystem7" /begin SUB_GROUP S4_MCU_STATUS_2 /end SUB_GROUP /begin REF_MEASUREMENT FAN_sign /end REF_MEASUREMENT /end GROUP
/begin GROUP Root_____ "text28/驱动系统" /begin SUB_GROUP S6_MCU_can__ S6_Subsystem S6_Subsystem2 /end SUB_GROUP /end GROUP
/begin GROUP S3_ReceiveMessages "text28/Function-Call Subsystem4/ReceiveMessages" /begin SUB_GROUP S19_BMS_HCU_INFO /end SUB_GROUP /end GROUP
/begin GROUP S3_can___ "text28/Function-Call Subsystem4/can断线 " /begin REF_MEASUREMENT bms_sign1 /end REF_MEASUREMENT /end GROUP
/begin GROUP S3___ "text28/Function-Call Subsystem4/可视" /begin REF_MEASUREMENT keshi /end REF_MEASUREMENT /end GROUP
/begin GROUP S4_MCU_STATUS_2 "text28/Function-Call Subsystem7/MCU_STATUS_2" /begin SUB_GROUP S45_MCU_STATUS_2 /end SUB_GROUP /end GROUP
/begin GROUP S6_MCU_can__ "text28/驱动系统/MCU_can总线" /begin REF_MEASUREMENT CAN_ok /end REF_MEASUREMENT /end GROUP
/begin GROUP S6_Subsystem "text28/驱动系统/Subsystem" /begin SUB_GROUP S80_____ S80______ S80_______ S80_appsrule /end SUB_GROUP /end GROUP
/begin GROUP S6_Subsystem2 "text28/驱动系统/Subsystem2" /begin REF_MEASUREMENT anquan_out /end REF_MEASUREMENT /end GROUP
/begin GROUP S19_BMS_HCU_INFO "text28/Function-Call Subsystem4/ReceiveMessages/BMS_HCU_INFO" /begin REF_MEASUREMENT baojing dianya soc zhuangtai /end REF_MEASUREMENT /end GROUP
/begin GROUP S45_MCU_STATUS_2 "text28/Function-Call Subsystem7/MCU_STATUS_2/MCU_STATUS_2" /begin REF_MEASUREMENT McuTemp MotorTemp /end REF_MEASUREMENT /end GROUP
/begin GROUP S80_appsrule "text28/驱动系统/Subsystem/appsrule" /begin SUB_GROUP S97_______ /end SUB_GROUP /begin REF_MEASUREMENT zuizhong /end REF_MEASUREMENT /end GROUP
/begin GROUP S80______ "text28/驱动系统/Subsystem/制动与尾灯" /begin SUB_GROUP S101______ S103__________ S103________________ /end SUB_GROUP /begin REF_MEASUREMENT jiaodu_11111 jiaodu_2222 youya1 youya2 youya3 /end REF_MEASUREMENT /end GROUP
/begin GROUP S80_______ "text28/驱动系统/Subsystem/制动与待驶 " /begin SUB_GROUP S99_____ /end SUB_GROUP /begin REF_MEASUREMENT enable_sign /end REF_MEASUREMENT /end GROUP
/begin GROUP S80_____ "text28/驱动系统/Subsystem/前轮转速" /begin SUB_GROUP S100___ S102_ReceiveMessages S102______ /end SUB_GROUP /end GROUP
/begin GROUP S97_______ "text28/驱动系统/Subsystem/appsrule/动力信号判断" /begin REF_MEASUREMENT apps_rule /end REF_MEASUREMENT /end GROUP
/begin GROUP S99_____ "text28/驱动系统/Subsystem/制动与待驶 /待驶按键" /begin REF_MEASUREMENT daishi /end REF_MEASUREMENT /end GROUP
/begin GROUP S100___ "text28/驱动系统/Subsystem/前轮转速/轮速" /begin REF_MEASUREMENT car_speed left_speed right_speed /end REF_MEASUREMENT /end GROUP
/begin GROUP S101______ "text28/驱动系统/Subsystem/滑转率计算/滑转率计算" /begin REF_MEASUREMENT huazhuan /end REF_MEASUREMENT /end GROUP
/begin GROUP S102_ReceiveMessages "text28/驱动系统/Subsystem/电机测速/ReceiveMessages" /begin REF_MEASUREMENT motor_speed motor_torque /end REF_MEASUREMENT /end GROUP
/begin GROUP S102______ "text28/驱动系统/Subsystem/电机测速/转速转轮速" /begin REF_MEASUREMENT rear_speed /end REF_MEASUREMENT /end GROUP
/begin GROUP S103________________ "text28/驱动系统/Subsystem/角度传感器/角度传感器数据处理及不可靠信号" /begin SUB_GROUP S165______ S165_______ S165________ /end SUB_GROUP /begin REF_MEASUREMENT app_date2 /end REF_MEASUREMENT /end GROUP
/begin GROUP S103__________ "text28/驱动系统/Subsystem/角度传感器/角度传感器是否正常" /begin REF_MEASUREMENT app_scs /end REF_MEASUREMENT /end GROUP
/begin GROUP S165________ "text28/驱动系统/Subsystem/角度传感器/角度传感器数据处理及不可靠信号/不可靠信号判断" /begin REF_MEASUREMENT apps_erro /end REF_MEASUREMENT /end GROUP
/begin GROUP S165______ "text28/驱动系统/Subsystem/角度传感器/角度传感器数据处理及不可靠信号/油门数值 " /begin SUB_GROUP S170___ S170___2 /end SUB_GROUP /begin REF_MEASUREMENT apple jiaodu1 jiaodu2 /end REF_MEASUREMENT /end GROUP
/begin GROUP S165_______ "text28/驱动系统/Subsystem/角度传感器/角度传感器数据处理及不可靠信号/百分比转化 " /begin SUB_GROUP S171_________1 S171_________2 /end SUB_GROUP /begin REF_MEASUREMENT baifenbi3 /end REF_MEASUREMENT /end GROUP
/begin GROUP S170___ "text28/驱动系统/Subsystem/角度传感器/角度传感器数据处理及不可靠信号/油门数值 /阈值" /begin REF_MEASUREMENT app_date1 /end REF_MEASUREMENT /end GROUP
/begin GROUP S170___2 "text28/驱动系统/Subsystem/角度传感器/角度传感器数据处理及不可靠信号/油门数值 /阈值2" /begin REF_MEASUREMENT app_baifenbi /end REF_MEASUREMENT /end GROUP
/begin GROUP S171_________1 "text28/驱动系统/Subsystem/角度传感器/角度传感器数据处理及不可靠信号/百分比转化 /角度归零化百分比1" /begin REF_MEASUREMENT baifenbi2 /end REF_MEASUREMENT /end GROUP
/begin GROUP S171_________2 "text28/驱动系统/Subsystem/角度传感器/角度传感器数据处理及不可靠信号/百分比转化 /角度归零化百分比2" /begin REF_MEASUREMENT baifenbi1 /end REF_MEASUREMENT /end GROUP
/end MODULE
/end PROJECT
/* (add any file trailer comments here) */
/* EOF text28.a2l */
